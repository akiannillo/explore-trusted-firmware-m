#! armclang --target=arm-arm-none-eabi -march=armv8-m.main -E -xc

/*
 * Copyright (c) 2017-2020 Arm Limited. All rights reserved.
 *
 * Licensed under the Apache License, Version 2.0 (the "License");
 * you may not use this file except in compliance with the License.
 * You may obtain a copy of the License at
 *
 *     http://www.apache.org/licenses/LICENSE-2.0
 *
 * Unless required by applicable law or agreed to in writing, software
 * distributed under the License is distributed on an "AS IS" BASIS,
 * WITHOUT WARRANTIES OR CONDITIONS OF ANY KIND, either express or implied.
 * See the License for the specific language governing permissions and
 * limitations under the License.
 */

/*********** WARNING: This is an auto-generated file. Do not edit! ***********/

/*
 * Customized region name prefix abbreviation:
 *  LR : A Load region.
 *  ER : A typical execution region.
 *  PT : An empty execution region used as position-tag/address-alignment.
 *
 * No applying customzied prefixes on linker/system reserved/intentional
 * names, such as 'ARM_LIB_STACK' or 'WATERMARK'.
 */

#include "region_defs.h"

LR_CODE S_CODE_START {

    PT_CODE_START S_CODE_START ALIGN 32 EMPTY 0x0 {
    }

    /**** This initial section contains mainly the SPM code */
    ER_TFM_CODE +0 ALIGN 32 {
        *.o (RESET +First)
        * (+RO-CODE)
    }

    /**** PSA RoT CODE starts here */

#ifdef TFM_PARTITION_INTERNAL_TRUSTED_STORAGE
    ER_TFM_SP_ITS_CODE +0 ALIGN 32 {
        *tfm_internal_trusted_storage* (+RO-CODE)
        *(TFM_SP_ITS_ATTR_FN)
    }
#endif /* TFM_PARTITION_INTERNAL_TRUSTED_STORAGE */

#ifdef TFM_PARTITION_AUDIT_LOG
    ER_TFM_SP_AUDIT_LOG_CODE +0 ALIGN 32 {
        *tfm_audit* (+RO-CODE)
        *(TFM_SP_AUDIT_LOG_ATTR_FN)
    }
#endif /* TFM_PARTITION_AUDIT_LOG */

#ifdef TFM_PARTITION_CRYPTO
    ER_TFM_SP_CRYPTO_CODE +0 ALIGN 32 {
        *tfm_crypto* (+RO-CODE)
        *(TFM_SP_CRYPTO_ATTR_FN)
    }
#endif /* TFM_PARTITION_CRYPTO */

#ifdef TFM_PARTITION_PLATFORM
    ER_TFM_SP_PLATFORM_CODE +0 ALIGN 32 {
        *tfm_platform* (+RO-CODE)
        *(TFM_SP_PLATFORM_ATTR_FN)
    }
#endif /* TFM_PARTITION_PLATFORM */

#ifdef TFM_PARTITION_INITIAL_ATTESTATION
    ER_TFM_SP_INITIAL_ATTESTATION_CODE +0 ALIGN 32 {
        *tfm_attest* (+RO-CODE)
        *(TFM_SP_INITIAL_ATTESTATION_ATTR_FN)
    }
#endif /* TFM_PARTITION_INITIAL_ATTESTATION */

#ifdef TFM_PARTITION_TEST_CORE
    ER_TFM_SP_CORE_TEST_CODE +0 ALIGN 32 {
        *tfm_ss_core_test.* (+RO-CODE)
        *(TFM_SP_CORE_TEST_ATTR_FN)
    }
#endif /* TFM_PARTITION_TEST_CORE */

#ifdef TFM_PARTITION_TEST_SECURE_SERVICES
    ER_TFM_SP_SECURE_TEST_PARTITION_CODE +0 ALIGN 32 {
        *tfm_secure_client_service.* (+RO-CODE)
        *test_framework* (+RO-CODE)
        *uart_stdout.* (+RO-CODE)
        *Driver_USART.* (+RO-CODE)
        *arm_uart_drv.* (+RO-CODE)
        *uart_pl011_drv.* (+RO-CODE)
        *uart_cmsdk_drv* (+RO-CODE)
        *secure_suites.* (+RO-CODE)
        *attestation_s_interface_testsuite.* (+RO-CODE)
        *(TFM_SP_SECURE_TEST_PARTITION_ATTR_FN)
    }
#endif /* TFM_PARTITION_TEST_SECURE_SERVICES */

#ifdef TFM_PARTITION_TEST_CORE_IPC
    ER_TFM_SP_IPC_SERVICE_TEST_CODE +0 ALIGN 32 {
        *tfm_ipc_service_test.* (+RO-CODE)
        *(TFM_SP_IPC_SERVICE_TEST_ATTR_FN)
    }
#endif /* TFM_PARTITION_TEST_CORE_IPC */

#ifdef TFM_PARTITION_TEST_PS
    ER_TFM_SP_PS_TEST_CODE +0 ALIGN 32 {
        *tfm_ps_test_service.* (+RO-CODE)
        *(TFM_SP_PS_TEST_ATTR_FN)
    }
#endif /* TFM_PARTITION_TEST_PS */


    /**** PSA RoT CODE ends here */

    /**** APPLICATION RoT CODE starts here */
    PT_APP_CODE_START +0 ALIGN 32 EMPTY 0x0 {
        /* Position tag */
    }

#ifdef TFM_PARTITION_PROTECTED_STORAGE
    ER_TFM_SP_PS_CODE +0 ALIGN 32 {
        *tfm_storage* (+RO-CODE)
        *test_ps_nv_counters.* (+RO-CODE)
        *(TFM_SP_PS_ATTR_FN)
    }
#endif /* TFM_PARTITION_PROTECTED_STORAGE */

#ifdef TFM_PARTITION_TEST_CORE
    ER_TFM_SP_CORE_TEST_2_CODE +0 ALIGN 32 {
        *tfm_ss_core_test_2.* (+RO-CODE)
        *(TFM_SP_CORE_TEST_2_ATTR_FN)
    }
#endif /* TFM_PARTITION_TEST_CORE */

#ifdef TFM_PARTITION_TEST_CORE_IPC
    ER_TFM_SP_IPC_CLIENT_TEST_CODE +0 ALIGN 32 {
        *tfm_ipc_client_test.* (+RO-CODE)
        *(TFM_SP_IPC_CLIENT_TEST_ATTR_FN)
    }
#endif /* TFM_PARTITION_TEST_CORE_IPC */

#ifdef TFM_ENABLE_IRQ_TEST
    ER_TFM_IRQ_TEST_1_CODE +0 ALIGN 32 {
        *tfm_irq_test_service_1.* (+RO-CODE)
        *timer_cmsdk* (+RO-CODE)
        *(TFM_IRQ_TEST_1_ATTR_FN)
    }
#endif /* TFM_ENABLE_IRQ_TEST */

#ifdef TFM_PARTITION_TEST_SECURE_SERVICES
    ER_TFM_SP_SECURE_CLIENT_2_CODE +0 ALIGN 32 {
        *tfm_secure_client_2.* (+RO-CODE)
        *(TFM_SP_SECURE_CLIENT_2_ATTR_FN)
    }
#endif /* TFM_PARTITION_TEST_SECURE_SERVICES */


    /**** APPLICATION RoT CODE ends here */
    PT_APP_CODE_END +0 ALIGN 32 EMPTY 0x0 {
        /* Position tag */
    }

    /**** Unprivileged Secure code starts here */
    ER_UNPRIV_CODE +0 ALIGN 32 {
        platform_retarget_dev.o (+RO-CODE)
        device_definition.o (+RO-CODE)
        *(SFN)
        *armlib* (+RO-CODE)
        *libtfmsprt.a (+RO-CODE)
    }

    PT_CODE_END +0 ALIGN 32 EMPTY 0x0 {
        /* Position tag */
    }

    PT_RODATA_START +0 ALIGN 32 EMPTY 0x0 {
        /* Position tag */
    }

    /****  This initial section contains mainly SPM RO data */
    ER_TFM_RODATA +0 ALIGN 32 {
        * (+RO-DATA)
    }

    /**** PSA RoT RO data starts here */

#ifdef TFM_PARTITION_INTERNAL_TRUSTED_STORAGE
    TFM_SP_ITS_RODATA +0 ALIGN 32 {
        *tfm_internal_trusted_storage* (+RO-DATA)
        *(TFM_SP_ITS_ATTR_RODATA)
    }
#endif /* TFM_PARTITION_INTERNAL_TRUSTED_STORAGE */

#ifdef TFM_PARTITION_AUDIT_LOG
    TFM_SP_AUDIT_LOG_RODATA +0 ALIGN 32 {
        *tfm_audit* (+RO-DATA)
        *(TFM_SP_AUDIT_LOG_ATTR_RODATA)
    }
#endif /* TFM_PARTITION_AUDIT_LOG */

#ifdef TFM_PARTITION_CRYPTO
    TFM_SP_CRYPTO_RODATA +0 ALIGN 32 {
        *tfm_crypto* (+RO-DATA)
        *(TFM_SP_CRYPTO_ATTR_RODATA)
    }
#endif /* TFM_PARTITION_CRYPTO */

#ifdef TFM_PARTITION_PLATFORM
    TFM_SP_PLATFORM_RODATA +0 ALIGN 32 {
        *tfm_platform* (+RO-DATA)
        *(TFM_SP_PLATFORM_ATTR_RODATA)
    }
#endif /* TFM_PARTITION_PLATFORM */

#ifdef TFM_PARTITION_INITIAL_ATTESTATION
    TFM_SP_INITIAL_ATTESTATION_RODATA +0 ALIGN 32 {
        *tfm_attest* (+RO-DATA)
        *(TFM_SP_INITIAL_ATTESTATION_ATTR_RODATA)
    }
#endif /* TFM_PARTITION_INITIAL_ATTESTATION */

#ifdef TFM_PARTITION_TEST_CORE
    TFM_SP_CORE_TEST_RODATA +0 ALIGN 32 {
        *tfm_ss_core_test.* (+RO-DATA)
        *(TFM_SP_CORE_TEST_ATTR_RODATA)
    }
#endif /* TFM_PARTITION_TEST_CORE */

#ifdef TFM_PARTITION_TEST_SECURE_SERVICES
    TFM_SP_SECURE_TEST_PARTITION_RODATA +0 ALIGN 32 {
        *tfm_secure_client_service.* (+RO-DATA)
        *test_framework* (+RO-DATA)
        *uart_stdout.* (+RO-DATA)
        *Driver_USART.* (+RO-DATA)
        *arm_uart_drv.* (+RO-DATA)
        *uart_pl011_drv.* (+RO-DATA)
        *uart_cmsdk_drv* (+RO-DATA)
        *secure_suites.* (+RO-DATA)
        *attestation_s_interface_testsuite.* (+RO-DATA)
        *(TFM_SP_SECURE_TEST_PARTITION_ATTR_RODATA)
    }
#endif /* TFM_PARTITION_TEST_SECURE_SERVICES */

#ifdef TFM_PARTITION_TEST_CORE_IPC
    TFM_SP_IPC_SERVICE_TEST_RODATA +0 ALIGN 32 {
        *tfm_ipc_service_test.* (+RO-DATA)
        *(TFM_SP_IPC_SERVICE_TEST_ATTR_RODATA)
    }
#endif /* TFM_PARTITION_TEST_CORE_IPC */

#ifdef TFM_PARTITION_TEST_PS
    TFM_SP_PS_TEST_RODATA +0 ALIGN 32 {
        *tfm_ps_test_service.* (+RO-DATA)
        *(TFM_SP_PS_TEST_ATTR_RODATA)
    }
#endif /* TFM_PARTITION_TEST_PS */


    /**** PSA RoT RO data ends here */
    /**** APPLICATION RoT RO data starts here */

#ifdef TFM_PARTITION_PROTECTED_STORAGE
    TFM_SP_PS_RODATA +0 ALIGN 32 {
        *tfm_storage* (+RO-DATA)
        *test_ps_nv_counters.* (+RO-DATA)
        *(TFM_SP_PS_ATTR_RODATA)
    }
#endif /* TFM_PARTITION_PROTECTED_STORAGE */

#ifdef TFM_PARTITION_TEST_CORE
    TFM_SP_CORE_TEST_2_RODATA +0 ALIGN 32 {
        *tfm_ss_core_test_2.* (+RO-DATA)
        *(TFM_SP_CORE_TEST_2_ATTR_RODATA)
    }
#endif /* TFM_PARTITION_TEST_CORE */

#ifdef TFM_PARTITION_TEST_CORE_IPC
    TFM_SP_IPC_CLIENT_TEST_RODATA +0 ALIGN 32 {
        *tfm_ipc_client_test.* (+RO-DATA)
        *(TFM_SP_IPC_CLIENT_TEST_ATTR_RODATA)
    }
#endif /* TFM_PARTITION_TEST_CORE_IPC */

#ifdef TFM_ENABLE_IRQ_TEST
    TFM_IRQ_TEST_1_RODATA +0 ALIGN 32 {
        *tfm_irq_test_service_1.* (+RO-DATA)
        *timer_cmsdk* (+RO-DATA)
        *(TFM_IRQ_TEST_1_ATTR_RODATA)
    }
#endif /* TFM_ENABLE_IRQ_TEST */

#ifdef TFM_PARTITION_TEST_SECURE_SERVICES
    TFM_SP_SECURE_CLIENT_2_RODATA +0 ALIGN 32 {
        *tfm_secure_client_2.* (+RO-DATA)
        *(TFM_SP_SECURE_CLIENT_2_ATTR_RODATA)
    }
#endif /* TFM_PARTITION_TEST_SECURE_SERVICES */


    /**** Unprivileged Secure RO data starts here */
    ER_UNPRIV_RODATA +0 ALIGN 32 {
        platform_retarget_dev.o (+RO-DATA)
        device_definition.o (+RO-DATA)
        *armlib* (+RO-DATA)
        *libtfmsprt.a (+RO-DATA)
    }

    PT_RODATA_END +0 ALIGN 32 EMPTY 0x0 {
        /* Position tag */
    }

    /**** Base address of secure data area */
    PT_SECURE_DATA_START S_DATA_START EMPTY 0x0 {
        /* Position tag */
    }

#if TFM_LVL == 1
    PT_RWZI_START +0 ALIGN 32 EMPTY 0x0 {
        /* Position tag */
    }
#endif

    /*
     * MPU on Armv6-M/v7-M core in multi-core topology may require more strict
     * alignment that MPU region base address must align with the MPU region
     * size.
     * As a result, in multi-core topology, to save memory resource and MPU
     * regions, unprivileged data sections and privileged data sections are
     * separated and gathered in unprivileged/privileged data area respectively.
     * Keep BL2 shared data and MSP stack at the beginning of the secure data
     * area in single Armv8-M topology, while move the two areas to the
     * beginning of privileged data region in multi-core topology.
     */
#ifndef TFM_MULTI_CORE_TOPOLOGY

    /* Shared area between BL2 and runtime to exchange data */
    TFM_SHARED_DATA +0 ALIGN 32 OVERLAY EMPTY BOOT_TFM_SHARED_DATA_SIZE {
    }

    /* MSP */
    ARM_LIB_STACK_MSP +0 ALIGN 32 OVERLAY EMPTY S_MSP_STACK_SIZE {
    }

#if TFM_LVL == 2
    PT_UNPRIV_RWZI_START +0 ALIGN 32 EMPTY 0x0 {
        /* Position tag */
    }
#endif

    /* PSP is unprivileged in single-core topology */
    ARM_LIB_STACK +0 ALIGN 32 EMPTY S_PSP_STACK_SIZE {
    }
#elif TFM_LVL == 2 /* Multi-core TFM LVL 2 */
    PT_UNPRIV_RWZI_START +0 ALIGN 32 EMPTY 0x0 {
        /* Position tag */
    }
#endif

#if !defined(TFM_PSA_API)
    TFM_SECURE_STACK +0 ALIGN 128 EMPTY 0x2000 {
    }
#endif /* !defined(TFM_PSA_API) */

    ER_UNPRIV_RWZI +0 ALIGN 32 {
    }

    /**** APPLICATION RoT RWZI starts here */
    PT_APP_RWZI_START +0 ALIGN 32 EMPTY 0x0 {
        /* Position tag */
    }

#ifdef TFM_PARTITION_PROTECTED_STORAGE
#if TFM_LVL == 3
    PT_TFM_SP_PS_PRIVATE_DATA_START +0 ALIGN 32 {
        /* Position tag */
    }
#endif
    ER_TFM_SP_PS_RWZI +0 ALIGN 32 {
        *tfm_storage* (+RW +ZI)
        *test_ps_nv_counters.* (+RW +ZI)
        *(TFM_SP_PS_ATTR_RW)
        *(TFM_SP_PS_ATTR_ZI)
    }
#if TFM_LVL == 3
    PT_TFM_SP_PS_PRIVATE_DATA_END +0 ALIGN 32 {
        /* Position tag */
    }
#endif
#endif /* TFM_PARTITION_PROTECTED_STORAGE */

#ifdef TFM_PARTITION_TEST_CORE
#if TFM_LVL == 3
    PT_TFM_SP_CORE_TEST_2_PRIVATE_DATA_START +0 ALIGN 32 {
        /* Position tag */
    }
#endif
    ER_TFM_SP_CORE_TEST_2_RWZI +0 ALIGN 32 {
        *tfm_ss_core_test_2.* (+RW +ZI)
        *(TFM_SP_CORE_TEST_2_ATTR_RW)
        *(TFM_SP_CORE_TEST_2_ATTR_ZI)
    }
#if TFM_LVL == 3
    PT_TFM_SP_CORE_TEST_2_PRIVATE_DATA_END +0 ALIGN 32 {
        /* Position tag */
    }
#endif
#endif /* TFM_PARTITION_TEST_CORE */

#ifdef TFM_PARTITION_TEST_CORE_IPC
#if TFM_LVL == 3
    PT_TFM_SP_IPC_CLIENT_TEST_PRIVATE_DATA_START +0 ALIGN 32 {
        /* Position tag */
    }
#endif
    ER_TFM_SP_IPC_CLIENT_TEST_RWZI +0 ALIGN 32 {
        *tfm_ipc_client_test.* (+RW +ZI)
        *(TFM_SP_IPC_CLIENT_TEST_ATTR_RW)
        *(TFM_SP_IPC_CLIENT_TEST_ATTR_ZI)
    }
#if TFM_LVL == 3
    PT_TFM_SP_IPC_CLIENT_TEST_PRIVATE_DATA_END +0 ALIGN 32 {
        /* Position tag */
    }
#endif
#endif /* TFM_PARTITION_TEST_CORE_IPC */

#ifdef TFM_ENABLE_IRQ_TEST
#if TFM_LVL == 3
    PT_TFM_IRQ_TEST_1_PRIVATE_DATA_START +0 ALIGN 32 {
        /* Position tag */
    }
#endif
    ER_TFM_IRQ_TEST_1_RWZI +0 ALIGN 32 {
        *tfm_irq_test_service_1.* (+RW +ZI)
        *timer_cmsdk* (+RW +ZI)
        *(TFM_IRQ_TEST_1_ATTR_RW)
        *(TFM_IRQ_TEST_1_ATTR_ZI)
    }
#if TFM_LVL == 3
    PT_TFM_IRQ_TEST_1_PRIVATE_DATA_END +0 ALIGN 32 {
        /* Position tag */
    }
#endif
#endif /* TFM_ENABLE_IRQ_TEST */

#ifdef TFM_PARTITION_TEST_SECURE_SERVICES
#if TFM_LVL == 3
    PT_TFM_SP_SECURE_CLIENT_2_PRIVATE_DATA_START +0 ALIGN 32 {
        /* Position tag */
    }
#endif
    ER_TFM_SP_SECURE_CLIENT_2_RWZI +0 ALIGN 32 {
        *tfm_secure_client_2.* (+RW +ZI)
        *(TFM_SP_SECURE_CLIENT_2_ATTR_RW)
        *(TFM_SP_SECURE_CLIENT_2_ATTR_ZI)
    }
#if TFM_LVL == 3
    PT_TFM_SP_SECURE_CLIENT_2_PRIVATE_DATA_END +0 ALIGN 32 {
        /* Position tag */
    }
#endif
#endif /* TFM_PARTITION_TEST_SECURE_SERVICES */


    /**** APPLICATION RoT RWZI ends here */
    PT_APP_RWZI_END +0 ALIGN 32 EMPTY 0x0 {
        /* Position tag */
    }

#if TFM_LVL == 2
    PT_UNPRIV_RWZI_END +0 ALIGN 32 EMPTY 0x0 {
        /* Position tag */
    }
#endif

#ifdef TFM_MULTI_CORE_TOPOLOGY

#ifdef S_DATA_PRIV_START
    /**** Privileged data area base address specified by multi-core platform */
    PT_SECURE_PRIV_DATA_BOUNDARY S_DATA_PRIV_START EMPTY 0x0 {
        /* Position tag */
    }
#endif

#if TFM_LVL == 2 || TFM_LVL == 3
    PT_PRIV_RWZI_START +0 ALIGN 32 EMPTY 0x0 {
        /* Position tag */
    }
#endif

    /*
     * Move BL2 shared area and MSP stack to the beginning of privileged data
     * area in multi-core topology.
     */
    /* Shared area between BL2 and runtime to exchange data */
    TFM_SHARED_DATA +0 ALIGN 32 OVERLAY EMPTY BOOT_TFM_SHARED_DATA_SIZE {
    }

    /* MSP */
    ARM_LIB_STACK_MSP +0 ALIGN 32 OVERLAY EMPTY S_MSP_STACK_SIZE {
    }

    /* PSP is privileged in multi-core topology */
    ARM_LIB_STACK +0 ALIGN 32 EMPTY S_PSP_STACK_SIZE {
    }
#elif TFM_LVL == 2 || TFM_LVL == 3 /* single-core L2 and L3 */
    PT_PRIV_RWZI_START +0 ALIGN 32 EMPTY 0x0 {
        /* Position tag */
    }
#endif

    ARM_LIB_HEAP +0 ALIGN 8 EMPTY S_HEAP_SIZE {
    }

    ER_TFM_DATA +0 {
        * (+RW +ZI)
    }

    /**** PSA RoT RWZI starts here */

#ifdef TFM_PARTITION_INTERNAL_TRUSTED_STORAGE
#if TFM_LVL == 3
    PT_TFM_SP_ITS_PRIVATE_DATA_START +0 ALIGN 32 {
        /* Position tag */
    }
#endif
    ER_TFM_SP_ITS_RWZI +0 ALIGN 32 {
        *tfm_internal_trusted_storage* (+RW +ZI)
        *(TFM_SP_ITS_ATTR_RW)
        *(TFM_SP_ITS_ATTR_ZI)
    }
#if TFM_LVL == 3
    PT_TFM_SP_ITS_PRIVATE_DATA_END +0 ALIGN 32 {
        /* Position tag */
    }
#endif
#endif /* TFM_PARTITION_INTERNAL_TRUSTED_STORAGE */

#ifdef TFM_PARTITION_AUDIT_LOG
#if TFM_LVL == 3
    PT_TFM_SP_AUDIT_LOG_PRIVATE_DATA_START +0 ALIGN 32 {
        /* Position tag */
    }
#endif
    ER_TFM_SP_AUDIT_LOG_RWZI +0 ALIGN 32 {
        *tfm_audit* (+RW +ZI)
        *(TFM_SP_AUDIT_LOG_ATTR_RW)
        *(TFM_SP_AUDIT_LOG_ATTR_ZI)
    }
#if TFM_LVL == 3
    PT_TFM_SP_AUDIT_LOG_PRIVATE_DATA_END +0 ALIGN 32 {
        /* Position tag */
    }
#endif
#endif /* TFM_PARTITION_AUDIT_LOG */

#ifdef TFM_PARTITION_CRYPTO
#if TFM_LVL == 3
    PT_TFM_SP_CRYPTO_PRIVATE_DATA_START +0 ALIGN 32 {
        /* Position tag */
    }
#endif
    ER_TFM_SP_CRYPTO_RWZI +0 ALIGN 32 {
        *tfm_crypto* (+RW +ZI)
        *(TFM_SP_CRYPTO_ATTR_RW)
        *(TFM_SP_CRYPTO_ATTR_ZI)
    }
#if TFM_LVL == 3
    PT_TFM_SP_CRYPTO_PRIVATE_DATA_END +0 ALIGN 32 {
        /* Position tag */
    }
#endif
#endif /* TFM_PARTITION_CRYPTO */

#ifdef TFM_PARTITION_PLATFORM
#if TFM_LVL == 3
    PT_TFM_SP_PLATFORM_PRIVATE_DATA_START +0 ALIGN 32 {
        /* Position tag */
    }
#endif
    ER_TFM_SP_PLATFORM_RWZI +0 ALIGN 32 {
        *tfm_platform* (+RW +ZI)
        *(TFM_SP_PLATFORM_ATTR_RW)
        *(TFM_SP_PLATFORM_ATTR_ZI)
    }
#if TFM_LVL == 3
    PT_TFM_SP_PLATFORM_PRIVATE_DATA_END +0 ALIGN 32 {
        /* Position tag */
    }
#endif
#endif /* TFM_PARTITION_PLATFORM */

#ifdef TFM_PARTITION_INITIAL_ATTESTATION
#if TFM_LVL == 3
    PT_TFM_SP_INITIAL_ATTESTATION_PRIVATE_DATA_START +0 ALIGN 32 {
        /* Position tag */
    }
#endif
    ER_TFM_SP_INITIAL_ATTESTATION_RWZI +0 ALIGN 32 {
        *tfm_attest* (+RW +ZI)
        *(TFM_SP_INITIAL_ATTESTATION_ATTR_RW)
        *(TFM_SP_INITIAL_ATTESTATION_ATTR_ZI)
    }
#if TFM_LVL == 3
    PT_TFM_SP_INITIAL_ATTESTATION_PRIVATE_DATA_END +0 ALIGN 32 {
        /* Position tag */
    }
#endif
#endif /* TFM_PARTITION_INITIAL_ATTESTATION */

#ifdef TFM_PARTITION_TEST_CORE
#if TFM_LVL == 3
    PT_TFM_SP_CORE_TEST_PRIVATE_DATA_START +0 ALIGN 32 {
        /* Position tag */
    }
#endif
    ER_TFM_SP_CORE_TEST_RWZI +0 ALIGN 32 {
        *tfm_ss_core_test.* (+RW +ZI)
        *(TFM_SP_CORE_TEST_ATTR_RW)
        *(TFM_SP_CORE_TEST_ATTR_ZI)
    }
#if TFM_LVL == 3
    PT_TFM_SP_CORE_TEST_PRIVATE_DATA_END +0 ALIGN 32 {
        /* Position tag */
    }
#endif
#endif /* TFM_PARTITION_TEST_CORE */

#ifdef TFM_PARTITION_TEST_SECURE_SERVICES
#if TFM_LVL == 3
    PT_TFM_SP_SECURE_TEST_PARTITION_PRIVATE_DATA_START +0 ALIGN 32 {
        /* Position tag */
    }
#endif
    ER_TFM_SP_SECURE_TEST_PARTITION_RWZI +0 ALIGN 32 {
        *tfm_secure_client_service.* (+RW +ZI)
        *test_framework* (+RW +ZI)
        *uart_stdout.* (+RW +ZI)
        *Driver_USART.* (+RW +ZI)
        *arm_uart_drv.* (+RW +ZI)
        *uart_pl011_drv.* (+RW +ZI)
        *uart_cmsdk_drv* (+RW +ZI)
        *secure_suites.* (+RW +ZI)
        *attestation_s_interface_testsuite.* (+RW +ZI)
        *(TFM_SP_SECURE_TEST_PARTITION_ATTR_RW)
        *(TFM_SP_SECURE_TEST_PARTITION_ATTR_ZI)
    }
#if TFM_LVL == 3
    PT_TFM_SP_SECURE_TEST_PARTITION_PRIVATE_DATA_END +0 ALIGN 32 {
        /* Position tag */
    }
#endif
#endif /* TFM_PARTITION_TEST_SECURE_SERVICES */

#ifdef TFM_PARTITION_TEST_CORE_IPC
#if TFM_LVL == 3
    PT_TFM_SP_IPC_SERVICE_TEST_PRIVATE_DATA_START +0 ALIGN 32 {
        /* Position tag */
    }
#endif
    ER_TFM_SP_IPC_SERVICE_TEST_RWZI +0 ALIGN 32 {
        *tfm_ipc_service_test.* (+RW +ZI)
        *(TFM_SP_IPC_SERVICE_TEST_ATTR_RW)
        *(TFM_SP_IPC_SERVICE_TEST_ATTR_ZI)
    }
#if TFM_LVL == 3
    PT_TFM_SP_IPC_SERVICE_TEST_PRIVATE_DATA_END +0 ALIGN 32 {
        /* Position tag */
    }
#endif
#endif /* TFM_PARTITION_TEST_CORE_IPC */

#ifdef TFM_PARTITION_TEST_PS
#if TFM_LVL == 3
    PT_TFM_SP_PS_TEST_PRIVATE_DATA_START +0 ALIGN 32 {
        /* Position tag */
    }
#endif
    ER_TFM_SP_PS_TEST_RWZI +0 ALIGN 32 {
        *tfm_ps_test_service.* (+RW +ZI)
        *(TFM_SP_PS_TEST_ATTR_RW)
        *(TFM_SP_PS_TEST_ATTR_ZI)
    }
#if TFM_LVL == 3
    PT_TFM_SP_PS_TEST_PRIVATE_DATA_END +0 ALIGN 32 {
        /* Position tag */
    }
#endif
#endif /* TFM_PARTITION_TEST_PS */


    /**** PSA RoT RWZI ends here */

#if TFM_LVL == 1
    PT_RWZI_END +0 ALIGN 32 EMPTY 0x0 {
        /* Position tag */
    }
#elif TFM_LVL == 2 || TFM_LVL == 3
    PT_PRIV_RWZI_END +0 ALIGN 32 EMPTY 0x0 {
        /* Position tag */
    }
#endif

#if defined (S_RAM_CODE_START)
    /* Executable code allocated in RAM */
    TFM_RAM_CODE S_RAM_CODE_START {
        * (.ramfunc)
    }
#endif

    PT_SRAM_WATERMARK +0 EMPTY 0x0 {
        /* Position tag */
    }

    /* Make sure that the sections allocated in the SRAM does not exceed the
     * size of the SRAM available.
     */
    ScatterAssert(ImageLimit(PT_SRAM_WATERMARK) <= S_DATA_START + S_DATA_SIZE)

#if defined(S_CODE_SRAM_ALIAS_BASE)
    /* eFlash driver code that gets copied from Flash to SRAM */
    ER_EFLASH_DRIVER_CODE S_CODE_SRAM_ALIAS_BASE ALIGN 32 {
        Driver_GFC100_EFlash.o (+RO-CODE)
        gfc100_eflash_drv.o (+RO-CODE)
        musca_b1_eflash_drv.o (+RO-CODE)
    }

    ER_EFLASH_DRIVER_RODATA +0 ALIGN 32 {
        Driver_GFC100_EFlash.o (+RO-DATA)
        gfc100_eflash_drv.o (+RO-DATA)
        musca_b1_eflash_drv.o (+RO-DATA)
    }
#endif
}

#ifndef TFM_MULTI_CORE_TOPOLOGY
LR_VENEER CMSE_VENEER_REGION_START {
    /*
     * Place the CMSE Veneers (containing the SG instruction) in a separate
     * 32 bytes aligned region so that the SAU can be programmed to
     * just set this region as Non-Secure Callable.
     */
    ER_CODE_CMSE_VENEER CMSE_VENEER_REGION_START CMSE_VENEER_REGION_SIZE {
        *(Veneer$$CMSE)
    }
}
#endif

LR_NS_PARTITION NS_PARTITION_START {
    /* Reserved place for NS application.
     * No code will be placed here, just address of this region is used in the
     * secure code to configure certain HW components. This generates an empty
     * execution region description warning during linking.
     */
    ER_NS_PARTITION NS_PARTITION_START UNINIT NS_PARTITION_SIZE {
    }
}

#ifdef BL2
LR_SECONDARY_PARTITION SECONDARY_PARTITION_START {
    /* Reserved place for new image in case of firmware upgrade.
     * No code will be placed here, just address of this region is used in the
     * secure code to configure certain HW components. This generates an empty
     * execution region description warning during linking.
     */
    ER_SECONDARY_PARTITION SECONDARY_PARTITION_START \
        UNINIT SECONDARY_PARTITION_SIZE {
    }
}
#endif /* BL2 */
